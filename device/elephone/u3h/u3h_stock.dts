/dts-v1/;

/ {

	fragment@0 {
		target = <0xffffffff>;

		__overlay__ {
			#address-cells = <0x02>;
			#size-cells = <0x02>;
			ranges;

			zmc-default {
				compatible = "mediatek,zone_movable_cma";
				size = <0x00 0xffc00000>;
				alignment = <0x00 0x10000000>;
				alloc-ranges = <0x00 0xc0000000 0x01 0x00>;
			};
		};
	};

	fragment@1 {
		target = <0xffffffff>;

		__overlay__ {
			atag,videolfb-fb_base_l = "^`P";
			atag,videolfb-fb_base_h = <0x00>;
			atag,videolfb-islcmfound = <0x01>;
			atag,videolfb-islcm_inited = <0x00>;
			atag,videolfb-fps = <0x1770>;
			atag,videolfb-vramSize = <0x17bb000>;
			atag,videolfb-lcmname = "nt35595_fhd_dsi_cmd_truly_nt50358_drv";
		};
	};

	fragment@2 {
		target = <0xffffffff>;

		__overlay__ {

			led@0 {
				compatible = "mediatek,red";
				led_mode = <0x00>;
				data = <0x01>;
				pwm_config = <0x00 0x00 0x00 0x00 0x00>;
				linux,phandle = <0x53>;
				phandle = <0x53>;
			};

			led@1 {
				compatible = "mediatek,green";
				led_mode = <0x00>;
				data = <0x01>;
				pwm_config = <0x00 0x00 0x00 0x00 0x00>;
				linux,phandle = <0x54>;
				phandle = <0x54>;
			};

			led@2 {
				compatible = "mediatek,blue";
				led_mode = <0x00>;
				data = <0x01>;
				pwm_config = <0x00 0x00 0x00 0x00 0x00>;
				linux,phandle = <0x55>;
				phandle = <0x55>;
			};

			led@3 {
				compatible = "mediatek,jogball-backlight";
				led_mode = <0x00>;
				data = <0x01>;
				pwm_config = <0x00 0x00 0x00 0x00 0x00>;
				linux,phandle = <0x56>;
				phandle = <0x56>;
			};

			led@4 {
				compatible = "mediatek,keyboard-backlight";
				led_mode = <0x00>;
				data = <0x01>;
				pwm_config = <0x00 0x00 0x00 0x00 0x00>;
				linux,phandle = <0x57>;
				phandle = <0x57>;
			};

			led@5 {
				compatible = "mediatek,button-backlight";
				led_mode = <0x00>;
				data = <0x01>;
				pwm_config = <0x00 0x00 0x00 0x00 0x00>;
				linux,phandle = <0x58>;
				phandle = <0x58>;
			};

			led@6 {
				compatible = "mediatek,lcd-backlight";
				led_mode = <0x05>;
				data = <0x01>;
				pwm_config = <0x00 0x01 0x00 0x00 0x00>;
				linux,phandle = <0x59>;
				phandle = <0x59>;
			};

			vibrator@0 {
				compatible = "mediatek,vibrator";
				vib_timer = <0x19>;
				vib_limit = <0x09>;
				vib_vol = <0x0b>;
				linux,phandle = <0x5a>;
				phandle = <0x5a>;
			};

			memory-ssmr-features {
				compatible = "mediatek,memory-ssmr-features";
				svp-size = <0x00 0x00>;
				iris-recognition-size = <0x00 0x00>;
				2d_fr-size = <0x00 0x00>;
				tui-size = <0x00 0x00>;
				wfd-size = <0x00 0x00>;
				prot-sharedmem-size = <0x00 0x00>;
				linux,phandle = <0x5b>;
				phandle = <0x5b>;
			};

			usb_c_pinctrl {
				compatible = "mediatek,usb_c_pinctrl";
				pinctrl-names = "usb_default\0redriver_c1_init\0redriver_c1_low\0redriver_c1_hiz\0redriver_c1_high\0redriver_c2_init\0redriver_c2_low\0redriver_c2_hiz\0redriver_c2_high\0u3_switch_sel1\0u3_switch_sel2\0u3_switch_enable\0u3_switch_disable";
				pinctrl-0 = <0x01>;
				pinctrl-1 = <0x02>;
				pinctrl-2 = <0x03>;
				pinctrl-3 = <0x04>;
				pinctrl-4 = <0x05>;
				pinctrl-5 = <0x06>;
				pinctrl-6 = <0x07>;
				pinctrl-7 = <0x08>;
				pinctrl-8 = <0x09>;
				pinctrl-9 = <0x0a>;
				pinctrl-10 = <0x0b>;
				pinctrl-11 = <0x0c>;
				pinctrl-12 = <0x0d>;
				status = "okay";
				linux,phandle = <0x5c>;
				phandle = <0x5c>;

				usb_switch-data {
					en_pin_num = <0x00>;
					en_pin_val = <0x00>;
					sel_pin_num = <0xb1>;
					sel_pin_val = <0x01>;
					c1_pin_num = <0x12>;
					c1_pin_val = <0x02>;
					c2_pin_num = <0x11>;
					c2_pin_val = <0x01>;
				};
			};
		};
	};

	fragment@3 {
		target = <0xffffffff>;

		__overlay__ {
			core_1 = "enable";
			scp_sramSize = <0x80000>;
		};
	};

	fragment@4 {
		target = <0xffffffff>;

		__overlay__ {
			tpd-resolution = <0x438 0x924>;
			use-tpd-button = <0x00>;
			tpd-key-num = <0x03>;
			tpd-key-local = <0x8b 0xac 0x9e 0x00>;
			tpd-key-dim-local = <0x5a 0x373 0x64 0x28 0xe6 0x373 0x64 0x28 0x172 0x373 0x64 0x28 0x00 0x00 0x00 0x00>;
			tpd-max-touch-num = <0x05>;
			tpd-filter-enable = <0x01>;
			tpd-filter-pixel-density = <0x92>;
			tpd-filter-custom-prameters = <0x00 0x00 0x00 0x00 0x00 0x00 0x00 0x00 0x00 0x00 0x00 0x00>;
			tpd-filter-custom-speed = <0x00 0x00 0x00>;
			pinctrl-names = "default\0state_eint_as_int\0state_eint_output0\0state_eint_output1\0state_rst_output0\0state_rst_output1";
			pinctrl-0 = <0x0e>;
			pinctrl-1 = <0x0f>;
			pinctrl-2 = <0x10>;
			pinctrl-3 = <0x11>;
			pinctrl-4 = <0x12>;
			pinctrl-5 = <0x13>;
			status = "okay";
		};
	};

	fragment@5 {
		target = <0xffffffff>;

		__overlay__ {

			eint0default {
				linux,phandle = <0x0e>;
				phandle = <0x0e>;
			};

			eint@0 {
				linux,phandle = <0x0f>;
				phandle = <0x0f>;

				pins_cmd_dat {
					pins = <0x100>;
					slew-rate = <0x00>;
					bias-disable;
				};
			};

			eintoutput0 {
				linux,phandle = <0x10>;
				phandle = <0x10>;

				pins_cmd_dat {
					pins = <0x100>;
					slew-rate = <0x01>;
					output-low;
				};
			};

			eintoutput1 {
				linux,phandle = <0x11>;
				phandle = <0x11>;

				pins_cmd_dat {
					pins = <0x100>;
					slew-rate = <0x01>;
					output-high;
				};
			};

			rstoutput0 {
				linux,phandle = <0x12>;
				phandle = <0x12>;

				pins_cmd_dat {
					pins = <0x1400>;
					slew-rate = <0x01>;
					output-low;
				};
			};

			rstoutput1 {
				linux,phandle = <0x13>;
				phandle = <0x13>;

				pins_cmd_dat {
					pins = <0x1400>;
					slew-rate = <0x01>;
					output-high;
				};
			};
		};
	};

	fragment@6 {
		target = <0xffffffff>;

		__overlay__ {
			#address-cells = <0x01>;
			#size-cells = <0x00>;
			status = "okay";

			fts_spi {
				compatible = "focaltech,fts";
				reg = <0x00>;
				spi-max-frequency = <0x2dc6c0>;
				pinctrl-names = "default\0state_spi";
				pinctrl-0 = <0x14>;
				pinctrl-1 = <0x15>;
				status = "okay";
				linux,phandle = <0x5d>;
				phandle = <0x5d>;
			};
		};
	};

	fragment@7 {
		target = <0xffffffff>;

		__overlay__ {

			spi_default {
				linux,phandle = <0x14>;
				phandle = <0x14>;
			};

			spi_state {
				linux,phandle = <0x15>;
				phandle = <0x15>;
			};
		};
	};

	fragment@8 {
		target = <0xffffffff>;

		__overlay__ {
			accdet-mic-vol = <0x06>;
			headset-mode-setting = <0x500 0x500 0x01 0x1f0 0x800 0x800 0x20 0x44>;
			accdet-plugout-debounce = <0x01>;
			accdet-mic-mode = <0x02>;
			headset-eint-level-pol = <0x08>;
			headset-three-key-threshold = <0x00 0x3c 0xc8 0x190>;
			headset-three-key-threshold-CDD = <0x00 0x79 0xc0 0x258>;
			headset-four-key-threshold = <0x00 0x3a 0x79 0xc0 0x190>;
			moisture-external-r = <0x1e8480>;
			moisture-internal-r = <0xb798>;
			moisture-water-r = <0x2710>;
			micgnd-sel-gpio = <0xffffffff 0x12 0x00>;
			usblr-sel-gpio = <0xffffffff 0x13 0x00>;
			pinctrl-names = "default\0state_eint_as_int\0state_audio_mode\0state_usb_mode\0state_micswitch_high\0state_micswitch_low";
			pinctrl-0 = <0x16>;
			pinctrl-1 = <0x17>;
			pinctrl-2 = <0x18>;
			pinctrl-3 = <0x19>;
			pinctrl-4 = <0x1a>;
			pinctrl-5 = <0x1b>;
			status = "okay";
		};
	};

	fragment@9 {
		target = <0xffffffff>;

		__overlay__ {

			accdetdefault {
				linux,phandle = <0x16>;
				phandle = <0x16>;
			};

			accdeteint@0 {
				linux,phandle = <0x17>;
				phandle = <0x17>;

				pins_cmd_dat {
					pins = <0x700>;
					slew-rate = <0x00>;
					bias-disable;
				};
			};

			accdetaudio@0 {
				linux,phandle = <0x18>;
				phandle = <0x18>;

				pins_cmd_dat {
					pins = <0x1300>;
					slew-rate = <0x01>;
					output-high;
				};
			};

			accdetusb@0 {
				linux,phandle = <0x19>;
				phandle = <0x19>;

				pins_cmd_dat {
					pins = <0x1300>;
					slew-rate = <0x01>;
					output-low;
				};
			};

			micswitchhigh@0 {
				linux,phandle = <0x1a>;
				phandle = <0x1a>;

				pins_cmd_dat {
					pins = <0x1200>;
					slew-rate = <0x01>;
					output-high;
				};
			};

			micswitchlow@0 {
				linux,phandle = <0x1b>;
				phandle = <0x1b>;

				pins_cmd_dat {
					pins = <0x1200>;
					slew-rate = <0x01>;
					output-low;
				};
			};
		};
	};

	fragment@10 {
		target = <0xffffffff>;

		__overlay__ {
			pinctrl-names = "aud_clk_mosi_off\0aud_clk_mosi_on\0aud_dat_mosi_off\0aud_dat_mosi_on\0aud_dat_miso_off\0aud_dat_miso_on\0aud_smartpa_off\0aud_smartpa_on\0vow_dat_miso_off\0vow_dat_miso_on\0vow_clk_miso_off\0vow_clk_miso_on";
			pinctrl-0 = <0x1c>;
			pinctrl-1 = <0x1d>;
			pinctrl-2 = <0x1e>;
			pinctrl-3 = <0x1f>;
			pinctrl-4 = <0x20>;
			pinctrl-5 = <0x21>;
			pinctrl-6 = <0x22>;
			pinctrl-7 = <0x23>;
			pinctrl-8 = <0x24>;
			pinctrl-9 = <0x25>;
			pinctrl-10 = <0x26>;
			pinctrl-11 = <0x27>;
			status = "okay";
		};
	};

	fragment@11 {
		target = <0xffffffff>;

		__overlay__ {

			aud_clk_mosi_off {
				linux,phandle = <0x1c>;
				phandle = <0x1c>;

				pins_cmd0_dat {
					pins = <0x8800>;
				};
			};

			aud_clk_mosi_on {
				linux,phandle = <0x1d>;
				phandle = <0x1d>;

				pins_cmd0_dat {
					pins = <0x8801>;
				};
			};

			aud_dat_mosi_off {
				linux,phandle = <0x1e>;
				phandle = <0x1e>;

				pins_cmd1_dat {
					pins = <0x8a00>;
				};

				pins_cmd2_dat {
					pins = <0x8b00>;
				};
			};

			aud_dat_mosi_on {
				linux,phandle = <0x1f>;
				phandle = <0x1f>;

				pins_cmd1_dat {
					pins = <0x8a01>;
				};

				pins_cmd2_dat {
					pins = <0x8b01>;
				};
			};

			aud_dat_miso_off {
				linux,phandle = <0x20>;
				phandle = <0x20>;

				pins_cmd1_dat {
					pins = <0x8e00>;
				};

				pins_cmd2_dat {
					pins = <0x8f00>;
				};
			};

			aud_dat_miso_on {
				linux,phandle = <0x21>;
				phandle = <0x21>;

				pins_cmd1_dat {
					pins = <0x8e01>;
				};

				pins_cmd2_dat {
					pins = <0x8f01>;
				};
			};

			aud_pins_smartpa_off {
				linux,phandle = <0x22>;
				phandle = <0x22>;

				pins_cmd0_dat {
					pins = <0xae00>;
				};

				pins_cmd1_dat {
					pins = <0xaa00>;
				};
			};

			aud_pins_smartpa_on {
				linux,phandle = <0x23>;
				phandle = <0x23>;

				pins_cmd0_dat {
					pins = <0xae02>;
				};

				pins_cmd1_dat {
					pins = <0xaa02>;
				};
			};

			vow_dat_miso_off {
				linux,phandle = <0x24>;
				phandle = <0x24>;

				pins_cmd1_dat {
					pins = <0x8e00>;
				};
			};

			vow_dat_miso_on {
				linux,phandle = <0x25>;
				phandle = <0x25>;

				pins_cmd1_dat {
					pins = <0x8e04>;
				};
			};

			vow_clk_miso_off {
				linux,phandle = <0x26>;
				phandle = <0x26>;

				pins_cmd3_dat {
					pins = <0x8f00>;
				};
			};

			vow_clk_miso_on {
				linux,phandle = <0x27>;
				phandle = <0x27>;

				pins_cmd3_dat {
					pins = <0x8f04>;
				};
			};
		};
	};

	fragment@12 {
		target = <0xffffffff>;

		__overlay__ {

			consys_default {
				linux,phandle = <0x28>;
				phandle = <0x28>;
			};

			gpslna@0 {
				linux,phandle = <0x29>;
				phandle = <0x29>;

				pins_cmd_dat {
					pins = <0x9b00>;
					slew-rate = <0x00>;
					bias-disable;
					output-low;
				};
			};

			gpslna@1 {
				linux,phandle = <0x2a>;
				phandle = <0x2a>;

				pins_cmd_dat {
					pins = <0x9b00>;
					slew-rate = <0x01>;
					output-high;
				};
			};

			gpslna@2 {
				linux,phandle = <0x2b>;
				phandle = <0x2b>;

				pins_cmd_dat {
					pins = <0x9b00>;
					slew-rate = <0x01>;
					output-low;
				};
			};
		};
	};

	fragment@13 {
		target = <0xffffffff>;

		__overlay__ {
			pinctrl-names = "default\0gps_lna_state_init\0gps_lna_state_oh\0gps_lna_state_ol";
			pinctrl-0 = <0x28>;
			pinctrl-1 = <0x29>;
			pinctrl-2 = <0x2a>;
			pinctrl-3 = <0x2b>;
			status = "okay";
		};
	};

	fragment@14 {
		target = <0xffffffff>;

		__overlay__ {

			cam0@0 {
				linux,phandle = <0x2d>;
				phandle = <0x2d>;

				pins_cmd_dat {
					pins = <0x6500>;
					slew-rate = <0x01>;
					output-low;
				};
			};

			cam0@1 {
				linux,phandle = <0x2e>;
				phandle = <0x2e>;

				pins_cmd_dat {
					pins = <0x6500>;
					slew-rate = <0x01>;
					output-high;
				};
			};

			cam0@2 {
				linux,phandle = <0x2f>;
				phandle = <0x2f>;

				pins_cmd_dat {
					pins = <0x6100>;
					slew-rate = <0x01>;
					output-low;
				};
			};

			cam0@3 {
				linux,phandle = <0x30>;
				phandle = <0x30>;

				pins_cmd_dat {
					pins = <0x6100>;
					slew-rate = <0x01>;
					output-high;
				};
			};

			cam1@0 {
				linux,phandle = <0x31>;
				phandle = <0x31>;

				pins_cmd_dat {
					pins = <0x6600>;
					slew-rate = <0x01>;
					output-low;
				};
			};

			cam1@1 {
				linux,phandle = <0x32>;
				phandle = <0x32>;

				pins_cmd_dat {
					pins = <0x6600>;
					slew-rate = <0x01>;
					output-high;
				};
			};

			cam1@2 {
				linux,phandle = <0x33>;
				phandle = <0x33>;

				pins_cmd_dat {
					pins = <0x6200>;
					slew-rate = <0x01>;
					output-low;
				};
			};

			cam1@3 {
				linux,phandle = <0x34>;
				phandle = <0x34>;

				pins_cmd_dat {
					pins = <0x6200>;
					slew-rate = <0x01>;
					output-high;
				};
			};

			cam2@0 {
				linux,phandle = <0x35>;
				phandle = <0x35>;

				pins_cmd_dat {
					pins = <0x6d00>;
					slew-rate = <0x01>;
					output-low;
				};
			};

			cam2@1 {
				linux,phandle = <0x36>;
				phandle = <0x36>;

				pins_cmd_dat {
					pins = <0x6d00>;
					slew-rate = <0x01>;
					output-high;
				};
			};

			cam2@3 {
				linux,phandle = <0x37>;
				phandle = <0x37>;

				pins_cmd_dat {
					pins = <0x6b00>;
					slew-rate = <0x01>;
					output-low;
				};
			};

			cam2@4 {
				linux,phandle = <0x38>;
				phandle = <0x38>;

				pins_cmd_dat {
					pins = <0x6b00>;
					slew-rate = <0x01>;
					output-high;
				};
			};

			cam2@vcam0 {
				linux,phandle = <0x39>;
				phandle = <0x39>;

				pins_cmd_dat {
					pins = <0xa900>;
					slew-rate = <0x01>;
					output-low;
				};

				pins_cam2af_dat {
					pins = <0x200>;
					slew-rate = <0x01>;
					output-low;
				};
			};

			cam1@vcam1 {
				linux,phandle = <0x3a>;
				phandle = <0x3a>;

				pins_cmd_dat {
					pins = <0xa900>;
					slew-rate = <0x01>;
					output-high;
				};

				pins_cam2af_dat {
					pins = <0x200>;
					slew-rate = <0x01>;
					output-high;
				};
			};

			cam1@vcam2 {
				linux,phandle = <0x3b>;
				phandle = <0x3b>;

				pins_cmd_dat {
					pins = <0xb200>;
					slew-rate = <0x01>;
					output-low;
				};
			};

			cam1@vcam3 {
				linux,phandle = <0x3c>;
				phandle = <0x3c>;

				pins_cmd_dat {
					pins = <0xb200>;
					slew-rate = <0x01>;
					output-high;
				};
			};

			camera_pins_cam0_mclk_on {
				linux,phandle = <0x3e>;
				phandle = <0x3e>;

				pins_cmd_dat {
					pins = <0x6301>;
				};
			};

			camera_pins_cam0_mclk_off {
				linux,phandle = <0x3d>;
				phandle = <0x3d>;

				pins_cmd_dat {
					pins = <0x6300>;
				};
			};

			camera_pins_cam1_mclk_off {
				linux,phandle = <0x3f>;
				phandle = <0x3f>;

				pins_cmd_dat {
					pins = <0x6400>;
				};
			};

			camera_pins_cam1_mclk_on {
				linux,phandle = <0x40>;
				phandle = <0x40>;

				pins_cmd_dat {
					pins = <0x6401>;
				};
			};

			camera_pins_cam2_mclk_off {
				linux,phandle = <0x41>;
				phandle = <0x41>;

				pins_cmd_dat {
					pins = <0x6c00>;
				};
			};

			camera_pins_cam2_mclk_on {
				linux,phandle = <0x42>;
				phandle = <0x42>;

				pins_cmd_dat {
					pins = <0x6c01>;
				};
			};

			camdefault {
				linux,phandle = <0x2c>;
				phandle = <0x2c>;
			};
		};
	};

	fragment@15 {
		target = <0xffffffff>;

		__overlay__ {
			pinctrl-names = "default\0cam0_rst0\0cam0_rst1\0cam0_pnd0\0cam0_pnd1\0cam1_rst0\0cam1_rst1\0cam1_pnd0\0cam1_pnd1\0cam2_rst0\0cam2_rst1\0cam2_pnd0\0cam2_pnd1\0cam_ldo_main2_vcamd_0\0cam_ldo_main2_vcamd_1\0cam_ldo_main2_vcama_0\0cam_ldo_main2_vcama_1\0cam0_mclk_off\0cam0_mclk_on\0cam1_mclk_off\0cam1_mclk_on\0cam2_mclk_off\0cam2_mclk_on";
			pinctrl-0 = <0x2c>;
			pinctrl-1 = <0x2d>;
			pinctrl-2 = <0x2e>;
			pinctrl-3 = <0x2f>;
			pinctrl-4 = <0x30>;
			pinctrl-5 = <0x31>;
			pinctrl-6 = <0x32>;
			pinctrl-7 = <0x33>;
			pinctrl-8 = <0x34>;
			pinctrl-9 = <0x35>;
			pinctrl-10 = <0x36>;
			pinctrl-11 = <0x37>;
			pinctrl-12 = <0x38>;
			pinctrl-13 = <0x39>;
			pinctrl-14 = <0x3a>;
			pinctrl-15 = <0x3b>;
			pinctrl-16 = <0x3c>;
			pinctrl-17 = <0x3d>;
			pinctrl-18 = <0x3e>;
			pinctrl-19 = <0x3f>;
			pinctrl-20 = <0x40>;
			pinctrl-21 = <0x41>;
			pinctrl-22 = <0x42>;
			status = "okay";
		};
	};

	fragment@16 {
		target = <0xffffffff>;

		__overlay__ {
			pinctrl-names = "uart0_gpio_default\0uart0_rx_set\0uart0_rx_clear\0uart0_tx_set\0uart0_tx_clear";
			pinctrl-0 = <0x43>;
			pinctrl-1 = <0x44>;
			pinctrl-2 = <0x45>;
			pinctrl-3 = <0x46>;
			pinctrl-4 = <0x47>;
			status = "okay";
		};
	};

	fragment@17 {
		target = <0xffffffff>;

		__overlay__ {

			uart0gpiodefault {
				linux,phandle = <0x43>;
				phandle = <0x43>;
			};

			uart0_rx_set@gpio95 {
				linux,phandle = <0x44>;
				phandle = <0x44>;

				pins_cmd_dat {
					pins = <0x5f01>;
				};
			};

			uart0_rx_clear@gpio95 {
				linux,phandle = <0x45>;
				phandle = <0x45>;

				pins_cmd_dat {
					pins = <0x5f00>;
					slew-rate = <0x01>;
					output-high;
				};
			};

			uart0_tx_set@gpio96 {
				linux,phandle = <0x46>;
				phandle = <0x46>;

				pins_cmd_dat {
					pins = <0x6001>;
				};
			};

			uart0_tx_clear@gpio96 {
				linux,phandle = <0x47>;
				phandle = <0x47>;

				pins_cmd_dat {
					pins = <0x6000>;
					slew-rate = <0x01>;
					output-high;
				};
			};
		};
	};

	fragment@18 {
		target = <0xffffffff>;

		__overlay__ {
			pinctrl-names = "irtx_gpio_led_default\0irtx_gpio_led_set";
			pinctrl-0 = <0x48>;
			pinctrl-1 = <0x49>;
			status = "okay";
		};
	};

	fragment@19 {
		target = <0xffffffff>;

		__overlay__ {

			irtx_gpio_led_def@gpio90 {
				linux,phandle = <0x48>;
				phandle = <0x48>;

				pins_cmd_dat {
					pins = <0x5a00>;
					slew-rate = <0x01>;
					bias-disable;
					output-low;
					input-schmitt-enable = <0x00>;
				};
			};

			irtx_gpio_led_set@gpio90 {
				linux,phandle = <0x49>;
				phandle = <0x49>;

				pins_cmd_dat {
					pins = <0x5a01>;
					slew-rate = <0x01>;
					output-high;
				};
			};
		};
	};

	fragment@20 {
		target = <0xffffffff>;

		__overlay__ {
			mt6370,intr_gpio_num = <0x0a>;
			mt6370,intr_gpio = <0xffffffff 0x0a 0x00>;
		};
	};

	fragment@21 {
		target = <0xffffffff>;

		__overlay__ {
			mt6370pd,intr_gpio_num = <0x29>;
			mt6370pd,intr_gpio = <0xffffffff 0x29 0x00>;
		};
	};

	fragment@22 {
		target = <0xffffffff>;

		__overlay__ {

			usb_default {
				linux,phandle = <0x01>;
				phandle = <0x01>;
			};

			c1_init {
				linux,phandle = <0x02>;
				phandle = <0x02>;

				pins_cmd_dat {
					pins = <0x1200>;
					slew-rate = <0x01>;
					output-low;
				};
			};

			c1_low {
				linux,phandle = <0x03>;
				phandle = <0x03>;

				pins_cmd_dat {
					pins = <0x1200>;
					slew-rate = <0x01>;
					output-low;
				};
			};

			c1_highz {
				linux,phandle = <0x04>;
				phandle = <0x04>;

				pins_cmd_dat {
					pins = <0x1200>;
					slew-rate = <0x00>;
					bias-disable;
				};
			};

			c1_high {
				linux,phandle = <0x05>;
				phandle = <0x05>;

				pins_cmd_dat {
					pins = <0x1200>;
					slew-rate = <0x01>;
					output-high;
				};
			};

			c2_init {
				linux,phandle = <0x06>;
				phandle = <0x06>;

				pins_cmd_dat {
					pins = <0x1100>;
					slew-rate = <0x01>;
					output-low;
				};
			};

			c2_low {
				linux,phandle = <0x07>;
				phandle = <0x07>;

				pins_cmd_dat {
					pins = <0x1100>;
					slew-rate = <0x01>;
					output-low;
				};
			};

			c2_highz {
				linux,phandle = <0x08>;
				phandle = <0x08>;

				pins_cmd_dat {
					pins = <0x1100>;
					slew-rate = <0x00>;
					bias-disable;
				};
			};

			c2_high {
				linux,phandle = <0x09>;
				phandle = <0x09>;

				pins_cmd_dat {
					pins = <0x1100>;
					slew-rate = <0x01>;
					output-high;
				};
			};

			u3_sw_sel1 {
				linux,phandle = <0x0a>;
				phandle = <0x0a>;

				pins_cmd_dat {
					pins = <0xb100>;
					slew-rate = <0x01>;
					output-low;
				};
			};

			u3_sw_sel2 {
				linux,phandle = <0x0b>;
				phandle = <0x0b>;

				pins_cmd_dat {
					pins = <0xb100>;
					slew-rate = <0x01>;
					output-high;
				};
			};

			u3_sw_en {
				linux,phandle = <0x0c>;
				phandle = <0x0c>;
			};

			u3_sw_dis {
				linux,phandle = <0x0d>;
				phandle = <0x0d>;
			};
		};
	};

	fragment@23 {
		target = <0xffffffff>;

		__overlay__ {

			aw87329@58 {
				compatible = "awinic,aw87329_pa";
				reg = <0x58>;
				reset-gpio = <0xffffffff 0x99 0x00>;
				status = "okay";
			};
		};
	};

	fragment@24 {
		target = <0xffffffff>;

		__overlay__ {

			sy65153@4b {
				compatible = "Silergy,sy65153";
				reg = <0x61>;
				status = "okay";
				sy,en_gpio_num = <0x07>;
				sy,en_gpio = <0xffffffff 0x07 0x00>;
				sy,intr_gpio_num = <0x09>;
				sy,intr_gpio = <0xffffffff 0x09 0x00>;
			};
		};
	};

	fragment@25 {
		target = <0xffffffff>;

		__overlay__ {
			pinctrl-names = "otg_en_default\0otg_en_high\0otg_en_low";
			pinctrl-0 = <0x4a>;
			pinctrl-1 = <0x4b>;
			pinctrl-2 = <0x4c>;
			status = "okay";
		};
	};

	fragment@26 {
		target = <0xffffffff>;

		__overlay__ {

			otg_en_default@gpio5 {
				linux,phandle = <0x4a>;
				phandle = <0x4a>;

				pins_cmd_dat {
					pins = <0x500>;
					slew-rate = <0x01>;
					output-low;
				};
			};

			otg_en_high@gpio5 {
				linux,phandle = <0x4b>;
				phandle = <0x4b>;

				pins_cmd_dat {
					pins = <0x500>;
					slew-rate = <0x01>;
					output-high;
				};
			};

			otg_en_low@gpio5 {
				linux,phandle = <0x4c>;
				phandle = <0x4c>;

				pins_cmd_dat {
					pins = <0x500>;
					slew-rate = <0x01>;
					output-low;
				};
			};
		};
	};

	fragment@27 {
		target = <0xffffffff>;

		__overlay__ {
			#address-cells = <0x01>;
			#size-cells = <0x00>;
			status = "okay";

			microarray_fp@0 {
				compatible = "mediatek,microarray_fp";
				reg = <0x00>;
				spi-max-frequency = <0x7a1200>;
				fingerprint,touch-int-gpio = <0xffffffff 0xa6 0x00>;
				status = "okay";
			};
		};
	};

	fragment@28 {
		target = <0xffffffff>;

		__overlay__ {

			finger_pin_default {
				linux,phandle = <0x4d>;
				phandle = <0x4d>;
			};

			finger_power_en@0 {
				linux,phandle = <0x4e>;
				phandle = <0x4e>;

				pins_cmd0_dat {
					pins = <0x1600>;
					slew-rate = <0x01>;
					output-low;
				};
			};

			finger_power_en@1 {
				linux,phandle = <0x4f>;
				phandle = <0x4f>;

				pins_cmd0_dat {
					pins = <0x1600>;
					slew-rate = <0x01>;
					output-high;
				};
			};

			finger_reset_en@0 {
				linux,phandle = <0x50>;
				phandle = <0x50>;

				pins_cmd_dat {
					pins = <0xa000>;
					slew-rate = <0x01>;
					output-low;
				};
			};

			finger_reset_en@1 {
				linux,phandle = <0x51>;
				phandle = <0x51>;

				pins_cmd_dat {
					pins = <0xa000>;
					slew-rate = <0x01>;
					output-high;
				};
			};

			finger_int_as_int@9 {
				linux,phandle = <0x52>;
				phandle = <0x52>;

				pins_cmd_dat {
					pins = <0xa600>;
					slew-rate = <0x00>;
					bias-pull-up = <0x00>;
				};
			};
		};
	};

	fragment@29 {
		target = <0xffffffff>;

		__overlay__ {
			pinctrl-names = "default\0finger_power_en0\0finger_power_en1\0finger_reset_en0\0finger_reset_en1\0finger_int_as_int";
			pinctrl-0 = <0x4d>;
			pinctrl-1 = <0x4e>;
			pinctrl-2 = <0x4f>;
			pinctrl-3 = <0x50>;
			pinctrl-4 = <0x51>;
			pinctrl-5 = <0x52>;
			status = "okay";
		};
	};

	fragment@30 {
		target = <0xffffffff>;

		__overlay__ {

			adc_channel@ {
				compatible = "mediatek,adc_channel";
				mediatek,temperature0 = <0x00>;
				mediatek,temperature1 = <0x01>;
				mediatek,adc_fdd_rf_params_dynamic_custom_ch = <0x02>;
				status = "okay";
			};
		};
	};

	fragment@31 {
		target = <0xffffffff>;

		__overlay__ {
			mediatek,clkbuf-quantity = <0x07>;
			mediatek,clkbuf-config = <0x02 0x01 0x01 0x02 0x00 0x00 0x01>;
			mediatek,clkbuf-driving-current = <0xffffffff 0xffffffff 0xffffffff 0xffffffff 0xffffffff 0xffffffff 0xffffffff>;
			status = "okay";
		};
	};

	fragment@32 {
		target = <0xffffffff>;

		__overlay__ {
			#address-cells = <0x01>;
			#size-cells = <0x00>;
			clock-frequency = <0x61a80>;
			mediatek,use-open-drain;

			cap_touch@70 {
				compatible = "mediatek,cap_touch";
				reg = <0x70>;
				status = "okay";
				linux,phandle = <0x5e>;
				phandle = <0x5e>;
			};
		};
	};

	fragment@33 {
		target = <0xffffffff>;

		__overlay__ {
			#address-cells = <0x01>;
			#size-cells = <0x00>;
			clock-frequency = <0x61a80>;
			mediatek,use-open-drain;

			msensor@0c {
				compatible = "mediatek,msensor";
				reg = <0x0c>;
				status = "okay";
				linux,phandle = <0x5f>;
				phandle = <0x5f>;
			};

			alsps@51 {
				compatible = "mediatek,alsps";
				reg = <0x51>;
				status = "okay";
				interrupt-parent = <0xffffffff>;
				interrupts = <0x06 0x08 0x06 0x00>;
				linux,phandle = <0x60>;
				phandle = <0x60>;
			};

			barometer@77 {
				compatible = "mediatek,barometer";
				reg = <0x77>;
				status = "okay";
				linux,phandle = <0x61>;
				phandle = <0x61>;
			};
		};
	};

	fragment@34 {
		target = <0xffffffff>;

		__overlay__ {
			#address-cells = <0x01>;
			#size-cells = <0x00>;
			clock-frequency = <0x61a80>;
			mediatek,use-open-drain;

			camera_main@1a {
				compatible = "mediatek,camera_main";
				reg = <0x1a>;
				status = "okay";
				linux,phandle = <0x62>;
				phandle = <0x62>;
			};

			camera_main_af@72 {
				compatible = "mediatek,camera_main_af";
				reg = <0x72>;
				status = "okay";
				linux,phandle = <0x63>;
				phandle = <0x63>;
			};

			camera_main_eeprom@50 {
				compatible = "mediatek,camera_main_eeprom";
				reg = <0x50>;
				status = "okay";
				linux,phandle = <0x64>;
				phandle = <0x64>;
			};

			ccu_sensor_i2c_main_hw@33 {
				compatible = "mediatek,ccu_sensor_i2c_main_hw";
				reg = <0x33>;
				status = "okay";
				linux,phandle = <0x65>;
				phandle = <0x65>;
			};
		};
	};

	fragment@35 {
		target = <0xffffffff>;

		__overlay__ {
			#address-cells = <0x01>;
			#size-cells = <0x00>;
			clock-frequency = <0x61a80>;
			mediatek,use-open-drain;

			nfc@08 {
				compatible = "mediatek,nfc";
				reg = <0x08>;
				status = "okay";
				linux,phandle = <0x66>;
				phandle = <0x66>;
			};
		};
	};

	fragment@36 {
		target = <0xffffffff>;

		__overlay__ {
			#address-cells = <0x01>;
			#size-cells = <0x00>;
			clock-frequency = <0x61a80>;
			mediatek,use-open-drain;

			camera_main_two@10 {
				compatible = "mediatek,camera_main_two";
				reg = <0x10>;
				status = "okay";
				linux,phandle = <0x67>;
				phandle = <0x67>;
			};

			camera_main_two_af@72 {
				compatible = "mediatek,camera_main_two_af";
				reg = <0x72>;
				status = "okay";
				linux,phandle = <0x68>;
				phandle = <0x68>;
			};

			camera_main_two_eeprom@51 {
				compatible = "mediatek,camera_main_two_eeprom";
				reg = <0x51>;
				status = "okay";
				linux,phandle = <0x69>;
				phandle = <0x69>;
			};

			camera_sub@35 {
				compatible = "mediatek,camera_sub";
				reg = <0x35>;
				status = "okay";
				linux,phandle = <0x6a>;
				phandle = <0x6a>;
			};

			camera_sub_eeprom@54 {
				compatible = "mediatek,camera_sub_eeprom";
				reg = <0x54>;
				status = "okay";
				linux,phandle = <0x6b>;
				phandle = <0x6b>;
			};

			ccu_sensor_i2c_main2_hw@36 {
				compatible = "mediatek,ccu_sensor_i2c_main2_hw";
				reg = <0x36>;
				status = "okay";
				linux,phandle = <0x6c>;
				phandle = <0x6c>;
			};

			ccu_sensor_i2c_sub_hw@43 {
				compatible = "mediatek,ccu_sensor_i2c_sub_hw";
				reg = <0x43>;
				status = "okay";
				linux,phandle = <0x6d>;
				phandle = <0x6d>;
			};
		};
	};

	fragment@37 {
		target = <0xffffffff>;

		__overlay__ {
			#address-cells = <0x01>;
			#size-cells = <0x00>;
			clock-frequency = <0x33e140>;
			mediatek,use-push-pull;

			usb_type_c@4e {
				compatible = "mediatek,usb_type_c";
				reg = <0x4e>;
				status = "okay";
				linux,phandle = <0x6e>;
				phandle = <0x6e>;
			};

			subpmic_pmu@34 {
				compatible = "mediatek,subpmic_pmu";
				reg = <0x34>;
				status = "okay";
				linux,phandle = <0x6f>;
				phandle = <0x6f>;
			};
		};
	};

	fragment@38 {
		target = <0xffffffff>;

		__overlay__ {
			#address-cells = <0x01>;
			#size-cells = <0x00>;
			clock-frequency = <0x61a80>;
			mediatek,use-open-drain;

			slave_charger@4b {
				compatible = "mediatek,slave_charger";
				reg = <0x4b>;
				status = "okay";
				linux,phandle = <0x70>;
				phandle = <0x70>;
			};
		};
	};

	fragment@39 {
		target = <0xffffffff>;

		__overlay__ {
			#address-cells = <0x01>;
			#size-cells = <0x00>;
			clock-frequency = <0x61a80>;
			mediatek,use-open-drain;
		};
	};

	fragment@40 {
		target = <0xffffffff>;

		__overlay__ {
			#address-cells = <0x01>;
			#size-cells = <0x00>;
			clock-frequency = <0x61a80>;
			mediatek,use-open-drain;
		};
	};

	fragment@41 {
		target = <0xffffffff>;

		__overlay__ {
			#address-cells = <0x01>;
			#size-cells = <0x00>;
			clock-frequency = <0x61a80>;
			mediatek,use-open-drain;
		};
	};

	fragment@42 {
		target = <0xffffffff>;

		__overlay__ {
			#address-cells = <0x01>;
			#size-cells = <0x00>;
			clock-frequency = <0x61a80>;
			mediatek,use-open-drain;
		};
	};

	fragment@43 {
		target = <0xffffffff>;

		__overlay__ {
			#address-cells = <0x01>;
			#size-cells = <0x00>;
			clock-frequency = <0x61a80>;
			mediatek,use-open-drain;
		};
	};

	fragment@44 {
		target = <0xffffffff>;

		__overlay__ {
			GPIO_SIM2_SIO = <0xffffffff 0x23 0x00>;
			GPIO_SIM2_SRST = <0xffffffff 0x24 0x00>;
			GPIO_SIM2_SCLK = <0xffffffff 0x25 0x00>;
			GPIO_SIM1_SCLK = <0xffffffff 0x26 0x00>;
			GPIO_SIM1_SRST = <0xffffffff 0x27 0x00>;
			GPIO_SIM1_SIO = <0xffffffff 0x28 0x00>;
			GPIO_SIM2_HOT_PLUG = <0xffffffff 0x2e 0x00>;
			GPIO_SIM1_HOT_PLUG = <0xffffffff 0x2f 0x00>;
		};
	};

	fragment@45 {
		target = <0xffffffff>;

		__overlay__ {
			gpio_init_default = <0x00 0x00 0x00 0x00 0x01 0x01 0x01 0x01 0x00 0x00 0x00 0x01 0x01 0x01 0x02 0x00 0x01 0x00 0x01 0x00 0x01 0x03 0x00 0x00 0x00 0x01 0x01 0x01 0x04 0x00 0x00 0x00 0x01 0x01 0x00 0x05 0x00 0x01 0x00 0x00 0x00 0x00 0x06 0x00 0x00 0x00 0x01 0x01 0x00 0x07 0x00 0x00 0x00 0x01 0x01 0x00 0x08 0x00 0x01 0x00 0x00 0x00 0x00 0x09 0x00 0x00 0x00 0x01 0x01 0x00 0x0a 0x00 0x00 0x00 0x01 0x01 0x00 0x0b 0x03 0x00 0x00 0x01 0x01 0x00 0x0c 0x03 0x00 0x00 0x01 0x01 0x00 0x0d 0x02 0x00 0x00 0x01 0x00 0x00 0x0e 0x02 0x01 0x00 0x00 0x00 0x00 0x0f 0x02 0x01 0x00 0x01 0x00 0x00 0x10 0x02 0x01 0x00 0x00 0x00 0x00 0x11 0x00 0x00 0x00 0x01 0x00 0x00 0x12 0x00 0x01 0x01 0x01 0x00 0x00 0x13 0x00 0x01 0x00 0x01 0x00 0x00 0x14 0x00 0x01 0x01 0x00 0x00 0x00 0x15 0x00 0x00 0x00 0x01 0x00 0x00 0x16 0x00 0x01 0x00 0x00 0x00 0x00 0x17 0x00 0x00 0x00 0x01 0x00 0x00 0x18 0x05 0x00 0x00 0x01 0x00 0x00 0x19 0x05 0x00 0x00 0x01 0x00 0x00 0x1a 0x05 0x00 0x00 0x01 0x00 0x00 0x1b 0x05 0x01 0x00 0x00 0x00 0x00 0x1c 0x05 0x00 0x00 0x01 0x01 0x00 0x1d 0x01 0x01 0x00 0x00 0x00 0x00 0x1e 0x01 0x00 0x00 0x01 0x01 0x00 0x1f 0x01 0x00 0x00 0x01 0x01 0x00 0x20 0x01 0x00 0x00 0x01 0x01 0x00 0x21 0x01 0x00 0x00 0x01 0x01 0x00 0x22 0x01 0x00 0x00 0x01 0x01 0x00 0x23 0x01 0x00 0x00 0x01 0x01 0x00 0x24 0x01 0x01 0x00 0x00 0x00 0x00 0x25 0x01 0x01 0x00 0x00 0x00 0x00 0x26 0x01 0x01 0x00 0x00 0x00 0x00 0x27 0x01 0x01 0x00 0x00 0x00 0x00 0x28 0x01 0x00 0x00 0x01 0x01 0x00 0x29 0x00 0x00 0x00 0x01 0x01 0x00 0x2a 0x00 0x01 0x00 0x00 0x00 0x00 0x2b 0x01 0x01 0x00 0x00 0x00 0x00 0x2c 0x01 0x00 0x00 0x01 0x00 0x00 0x2d 0x01 0x01 0x01 0x00 0x00 0x00 0x2e 0x01 0x00 0x00 0x01 0x01 0x00 0x2f 0x01 0x00 0x00 0x01 0x01 0x00 0x30 0x01 0x00 0x00 0x01 0x01 0x00 0x31 0x01 0x00 0x00 0x01 0x01 0x00 0x32 0x01 0x00 0x00 0x01 0x01 0x00 0x33 0x01 0x00 0x00 0x01 0x01 0x00 0x34 0x01 0x01 0x00 0x01 0x00 0x00 0x35 0x01 0x01 0x00 0x01 0x00 0x00 0x36 0x01 0x01 0x00 0x01 0x00 0x00 0x37 0x01 0x01 0x00 0x01 0x00 0x00 0x38 0x01 0x01 0x00 0x01 0x00 0x00 0x39 0x01 0x01 0x00 0x01 0x00 0x00 0x3a 0x00 0x00 0x00 0x01 0x00 0x00 0x3b 0x01 0x00 0x00 0x01 0x00 0x00 0x3c 0x01 0x00 0x00 0x01 0x00 0x00 0x3d 0x01 0x00 0x00 0x01 0x00 0x00 0x3e 0x01 0x00 0x00 0x01 0x00 0x00 0x3f 0x01 0x00 0x00 0x01 0x00 0x00 0x40 0x01 0x00 0x00 0x01 0x00 0x00 0x41 0x02 0x00 0x00 0x01 0x00 0x00 0x42 0x02 0x00 0x00 0x01 0x00 0x00 0x43 0x01 0x00 0x00 0x01 0x00 0x00 0x44 0x01 0x00 0x00 0x01 0x00 0x00 0x45 0x00 0x01 0x01 0x00 0x00 0x00 0x46 0x00 0x00 0x00 0x01 0x00 0x00 0x47 0x01 0x01 0x00 0x01 0x00 0x00 0x48 0x01 0x01 0x00 0x01 0x00 0x00 0x49 0x01 0x01 0x00 0x01 0x00 0x00 0x4a 0x01 0x01 0x00 0x01 0x00 0x00 0x4b 0x01 0x01 0x00 0x01 0x00 0x00 0x4c 0x01 0x01 0x00 0x01 0x00 0x00 0x4d 0x01 0x01 0x00 0x01 0x00 0x00 0x4e 0x01 0x01 0x00 0x01 0x00 0x00 0x4f 0x01 0x00 0x00 0x01 0x00 0x00 0x50 0x01 0x00 0x00 0x01 0x00 0x00 0x51 0x01 0x00 0x00 0x01 0x01 0x00 0x52 0x01 0x00 0x00 0x01 0x01 0x00 0x53 0x01 0x00 0x00 0x01 0x01 0x00 0x54 0x01 0x00 0x00 0x01 0x01 0x00 0x55 0x01 0x00 0x00 0x01 0x00 0x00 0x56 0x01 0x01 0x01 0x00 0x00 0x00 0x57 0x01 0x01 0x00 0x00 0x00 0x00 0x58 0x01 0x01 0x00 0x00 0x00 0x00 0x59 0x01 0x00 0x00 0x01 0x00 0x00 0x5a 0x01 0x01 0x00 0x00 0x00 0x00 0x5b 0x00 0x00 0x00 0x01 0x00 0x00 0x5c 0x01 0x01 0x00 0x01 0x00 0x00 0x5d 0x01 0x00 0x00 0x01 0x01 0x00 0x5e 0x01 0x00 0x00 0x01 0x01 0x00 0x5f 0x01 0x00 0x00 0x01 0x01 0x00 0x60 0x01 0x01 0x00 0x00 0x00 0x00 0x61 0x00 0x01 0x00 0x00 0x00 0x00 0x62 0x00 0x01 0x00 0x00 0x00 0x00 0x63 0x00 0x01 0x00 0x00 0x00 0x00 0x64 0x00 0x01 0x00 0x00 0x00 0x00 0x65 0x00 0x01 0x01 0x00 0x00 0x00 0x66 0x00 0x01 0x01 0x00 0x00 0x00 0x67 0x01 0x00 0x00 0x01 0x01 0x00 0x68 0x01 0x00 0x00 0x01 0x01 0x00 0x69 0x01 0x00 0x00 0x01 0x01 0x00 0x6a 0x01 0x00 0x00 0x01 0x01 0x00 0x6b 0x00 0x01 0x00 0x00 0x00 0x00 0x6c 0x00 0x01 0x00 0x00 0x00 0x00 0x6d 0x00 0x01 0x01 0x00 0x00 0x00 0x6e 0x07 0x00 0x00 0x01 0x01 0x00 0x6f 0x00 0x00 0x00 0x00 0x00 0x00 0x70 0x07 0x01 0x00 0x00 0x00 0x00 0x71 0x00 0x00 0x00 0x01 0x00 0x00 0x72 0x00 0x00 0x00 0x01 0x00 0x00 0x73 0x00 0x00 0x00 0x01 0x00 0x00 0x74 0x00 0x00 0x00 0x01 0x00 0x00 0x75 0x00 0x00 0x00 0x01 0x00 0x00 0x76 0x00 0x00 0x00 0x01 0x00 0x00 0x77 0x00 0x00 0x00 0x01 0x00 0x00 0x78 0x00 0x00 0x00 0x01 0x00 0x00 0x79 0x00 0x00 0x00 0x01 0x00 0x00 0x7a 0x01 0x00 0x00 0x01 0x01 0x00 0x7b 0x01 0x00 0x00 0x01 0x01 0x00 0x7c 0x01 0x01 0x00 0x00 0x00 0x00 0x7d 0x01 0x00 0x00 0x01 0x01 0x00 0x7e 0x01 0x00 0x00 0x01 0x01 0x00 0x7f 0x01 0x00 0x00 0x01 0x01 0x00 0x80 0x01 0x00 0x00 0x01 0x01 0x00 0x81 0x01 0x00 0x00 0x01 0x01 0x00 0x82 0x01 0x00 0x00 0x01 0x01 0x00 0x83 0x01 0x00 0x00 0x01 0x00 0x00 0x84 0x01 0x00 0x00 0x01 0x01 0x00 0x85 0x01 0x01 0x01 0x00 0x00 0x00 0x86 0x01 0x00 0x00 0x01 0x00 0x01 0x87 0x01 0x01 0x00 0x00 0x00 0x00 0x88 0x01 0x01 0x00 0x01 0x00 0x00 0x89 0x01 0x01 0x00 0x01 0x00 0x00 0x8a 0x01 0x01 0x00 0x00 0x00 0x00 0x8b 0x01 0x01 0x00 0x01 0x00 0x00 0x8c 0x01 0x00 0x00 0x00 0x00 0x00 0x8d 0x01 0x00 0x00 0x00 0x00 0x00 0x8e 0x01 0x00 0x00 0x00 0x00 0x00 0x8f 0x01 0x00 0x00 0x00 0x00 0x00 0x90 0x01 0x00 0x00 0x01 0x00 0x00 0x91 0x01 0x01 0x01 0x00 0x00 0x00 0x92 0x01 0x00 0x00 0x01 0x00 0x00 0x93 0x01 0x01 0x00 0x00 0x00 0x00 0x94 0x01 0x01 0x00 0x00 0x00 0x00 0x95 0x01 0x01 0x00 0x00 0x00 0x00 0x96 0x00 0x01 0x00 0x00 0x00 0x00 0x97 0x00 0x01 0x00 0x00 0x00 0x00 0x98 0x00 0x01 0x00 0x00 0x00 0x00 0x99 0x00 0x01 0x01 0x00 0x00 0x00 0x9a 0x01 0x01 0x00 0x00 0x00 0x00 0x9b 0x01 0x00 0x00 0x01 0x00 0x00 0x9c 0x00 0x00 0x00 0x01 0x00 0x00 0x9d 0x00 0x00 0x00 0x01 0x00 0x00 0x9e 0x00 0x00 0x00 0x01 0x01 0x00 0x9f 0x00 0x00 0x00 0x01 0x01 0x00 0xa0 0x00 0x01 0x00 0x00 0x00 0x00 0xa1 0x02 0x00 0x00 0x01 0x00 0x00 0xa2 0x02 0x01 0x01 0x00 0x00 0x00 0xa3 0x02 0x01 0x00 0x00 0x00 0x00 0xa4 0x02 0x01 0x00 0x00 0x00 0x00 0xa5 0x00 0x01 0x01 0x00 0x00 0x00 0xa6 0x00 0x00 0x00 0x00 0x00 0x00 0xa7 0x01 0x01 0x00 0x01 0x00 0x00 0xa8 0x01 0x01 0x00 0x01 0x00 0x00 0xa9 0x00 0x01 0x00 0x00 0x00 0x00 0xaa 0x02 0x01 0x00 0x01 0x00 0x00 0xab 0x02 0x01 0x00 0x01 0x00 0x00 0xac 0x02 0x01 0x00 0x01 0x00 0x00 0xad 0x00 0x00 0x00 0x01 0x00 0x00 0xae 0x02 0x00 0x00 0x01 0x00 0x00 0xaf 0x00 0x00 0x00 0x00 0x00 0x00 0xb0 0x00 0x01 0x00 0x00 0x00 0x00 0xb1 0x00 0x01 0x00 0x00 0x00 0x00 0xb2 0x00 0x01 0x00 0x00 0x00 0x00 0xb3 0x00 0x01 0x00 0x00 0x00 0x00 0xb4 0x00 0x00 0x00 0x01 0x00 0x00 0xb5 0x00 0x00 0x00 0x01 0x00 0x00 0xb6 0x00 0x00 0x00 0x01 0x00 0x00 0xb7 0x00 0x00 0x00 0x01 0x00 0x00 0xb8 0x00 0x00 0x00 0x01 0x00 0x00 0xb9 0x00 0x00 0x00 0x01 0x00 0x00 0xba 0x00 0x00 0x00 0x01 0x00 0x00 0xbb 0x00 0x00 0x00 0x01 0x00 0x00 0xbc 0x00 0x00 0x00 0x01 0x00 0x00 0xbd 0x00 0x00 0x00 0x01 0x00 0x00 0xbe 0x00 0x00 0x00 0x01 0x00 0x00 0xbf 0x00 0x00 0x00 0x01 0x00 0x00>;
		};
	};

	fragment@46 {
		target = <0xffffffff>;

		__overlay__ {
			interrupt-parent = <0xffffffff>;
			interrupts = <0x00 0x08 0x00 0x00>;
			deb-gpios = <0xffffffff 0x00 0x00>;
			debounce = <0x7d000>;
			status = "okay";
		};
	};

	fragment@47 {
		target = <0xffffffff>;

		__overlay__ {
			interrupt-parent = <0xffffffff>;
			interrupts = <0x01 0x02 0x01 0x00>;
			status = "okay";
		};
	};

	fragment@48 {
		target = <0xffffffff>;

		__overlay__ {
			interrupt-parent = <0xffffffff>;
			interrupts = <0x03 0x04 0x03 0x00>;
			deb-gpios = <0xffffffff 0x03 0x00>;
			debounce = <0x3e800>;
			status = "okay";
		};
	};

	fragment@49 {
		target = <0xffffffff>;

		__overlay__ {
			interrupt-parent = <0xffffffff>;
			interrupts = <0x04 0x08 0x04 0x00>;
			status = "okay";
		};
	};

	fragment@50 {
		target = <0xffffffff>;

		__overlay__ {
			interrupt-parent = <0xffffffff>;
			interrupts = <0x05 0x04 0x05 0x00>;
			status = "okay";
		};
	};

	fragment@51 {
		target = <0xffffffff>;

		__overlay__ {
			interrupt-parent = <0xffffffff>;
			interrupts = <0x07 0x08 0x07 0x00>;
			deb-gpios = <0xffffffff 0x07 0x00>;
			debounce = <0x3e800>;
			status = "okay";
		};
	};

	fragment@52 {
		target = <0xffffffff>;

		__overlay__ {
			interrupt-parent = <0xffffffff>;
			interrupts = <0x09 0x08 0x09 0x00>;
			status = "okay";
		};
	};

	fragment@53 {
		target = <0xffffffff>;

		__overlay__ {
			interrupt-parent = <0xffffffff>;
			interrupts = <0x0a 0x08 0x0a 0x00>;
			status = "okay";
		};
	};

	fragment@54 {
		target = <0xffffffff>;

		__overlay__ {
			interrupt-parent = <0xffffffff>;
			interrupts = <0x29 0x08 0x29 0x00>;
			status = "okay";
		};
	};

	fragment@55 {
		target = <0xffffffff>;

		__overlay__ {
			interrupt-parent = <0xffffffff>;
			interrupts = <0x2c 0x01 0x2c 0x01>;
			status = "okay";
		};
	};

	fragment@56 {
		target = <0xffffffff>;

		__overlay__ {
			interrupt-parent = <0xffffffff>;
			interrupts = <0x46 0x04 0x46 0x00>;
			status = "okay";
		};
	};

	fragment@57 {
		target = <0xffffffff>;

		__overlay__ {
			interrupt-parent = <0xffffffff>;
			interrupts = <0xa6 0x01 0xa6 0x00>;
			status = "okay";
		};
	};

	fragment@58 {
		target = <0xffffffff>;

		__overlay__ {
			interrupt-parent = <0xffffffff>;
			interrupts = <0xb6 0x04 0xbe 0x00>;
			status = "okay";
		};
	};

	fragment@59 {
		target = <0xffffffff>;

		__overlay__ {
			interrupt-parent = <0xffffffff>;
			interrupts = <0xba 0x08 0xad 0x00>;
			status = "okay";
		};
	};

	fragment@60 {
		target = <0xffffffff>;

		__overlay__ {
			compatible = "mediatek,md1_sim1_hot_plug_eint-eint";
			interrupts = <0x00 0x08>;
			debounce = <0x00 0x186a0>;
			dedicated = <0x00 0x00>;
			src_pin = <0x00 0x01>;
			sockettype = <0x00 0x00>;
			status = "okay";
		};
	};

	fragment@61 {
		target = <0xffffffff>;

		__overlay__ {
			compatible = "mediatek,md1_sim2_hot_plug_eint-eint";
			interrupts = <0x01 0x08>;
			debounce = <0x01 0x186a0>;
			dedicated = <0x01 0x00>;
			src_pin = <0x01 0x02>;
			sockettype = <0x01 0x00>;
			status = "okay";
		};
	};

	fragment@62 {
		target = <0xffffffff>;

		__overlay__ {
			regulator-name = "vcama1";
			regulator-default-on = <0x01>;
			status = "okay";
		};
	};

	fragment@63 {
		target = <0xffffffff>;

		__overlay__ {
			regulator-name = "vcama2";
			regulator-default-on = <0x01>;
			status = "okay";
		};
	};

	fragment@64 {
		target = <0xffffffff>;

		__overlay__ {
			regulator-name = "vsim1";
			regulator-default-on = <0x01>;
			status = "okay";
		};
	};

	fragment@65 {
		target = <0xffffffff>;

		__overlay__ {
			regulator-name = "vsim2";
			regulator-default-on = <0x01>;
			status = "okay";
		};
	};

	fragment@66 {
		target = <0xffffffff>;

		__overlay__ {
			regulator-name = "vcamd";
			regulator-default-on = <0x01>;
			status = "okay";
		};
	};

	fragment@67 {
		target = <0xffffffff>;

		__overlay__ {
			regulator-name = "vcamio";
			regulator-default-on = <0x01>;
			status = "okay";
		};
	};

	fragment@68 {
		target = <0xffffffff>;

		__overlay__ {
			regulator-name = "vldo28";
			regulator-default-on = <0x01>;
			status = "okay";
		};
	};

	fragment@69 {
		target = <0xffffffff>;

		__overlay__ {
			vcama_sub-supply = <0xffffffff>;
			vcama-supply = <0xffffffff>;
			vcamd-supply = <0xffffffff>;
			vcamd_sub-supply = <0xffffffff>;
			vcamio-supply = <0xffffffff>;
			vcamio_sub-supply = <0xffffffff>;
			vcamio_main2-supply = <0xffffffff>;
			vcamaf-supply = <0xffffffff>;
			vcamaf_sub-supply = <0xffffffff>;
			vcamaf_main2-supply = <0xffffffff>;
			status = "okay";
		};
	};

	fragment@70 {
		target = <0xffffffff>;

		__overlay__ {
			vtouch-supply = <0xffffffff>;
			status = "okay";
		};
	};

	fragment@71 {
		target = <0xffffffff>;

		__overlay__ {
			mediatek,kpd-key-debounce = <0x400>;
			mediatek,kpd-sw-pwrkey = <0x74>;
			mediatek,kpd-hw-pwrkey = <0x08>;
			mediatek,kpd-use-extend-type = <0x00>;
			mediatek,kpd-hw-map-num = <0x48>;
			mediatek,kpd-hw-init-map = <0x72 0x73 0x00 0x00 0x00 0x00 0x00 0x00 0x00 0x00 0x00 0x00 0x00 0x00 0x00 0x00 0x00 0x00 0x00 0x00 0x00 0x00 0x00 0x00 0x00 0x00 0x00 0x00 0x00 0x00 0x00 0x00 0x00 0x00 0x00 0x00 0x00 0x00 0x00 0x00 0x00 0x00 0x00 0x00 0x00 0x00 0x00 0x00 0x00 0x00 0x00 0x00 0x00 0x00 0x00 0x00 0x00 0x00 0x00 0x00 0x00 0x00 0x00 0x00 0x00 0x00 0x00 0x00 0x00 0x00 0x00 0x00>;
			mediatek,kpd-pwrkey-eint-gpio = <0x00>;
			mediatek,kpd-pwkey-gpio-din = <0x00>;
			mediatek,kpd-hw-dl-key0 = <0x01>;
			mediatek,kpd-hw-dl-key1 = <0x00>;
			mediatek,kpd-hw-dl-key2 = <0x08>;
			mediatek,kpd-hw-recovery-key = <0x01>;
			mediatek,kpd-hw-factory-key = <0x00>;
			status = "okay";
		};
	};

	__symbols__ {
		led0 = "/fragment@2/__overlay__/led@0";
		led1 = "/fragment@2/__overlay__/led@1";
		led2 = "/fragment@2/__overlay__/led@2";
		led3 = "/fragment@2/__overlay__/led@3";
		led4 = "/fragment@2/__overlay__/led@4";
		led5 = "/fragment@2/__overlay__/led@5";
		led6 = "/fragment@2/__overlay__/led@6";
		vibrator0 = "/fragment@2/__overlay__/vibrator@0";
		memory_ssmr_features = "/fragment@2/__overlay__/memory-ssmr-features";
		usb_c_pinctrl = "/fragment@2/__overlay__/usb_c_pinctrl";
		ctp_pins_default = "/fragment@5/__overlay__/eint0default";
		ctp_pins_eint_as_int = "/fragment@5/__overlay__/eint@0";
		ctp_pins_eint_output0 = "/fragment@5/__overlay__/eintoutput0";
		ctp_pins_eint_output1 = "/fragment@5/__overlay__/eintoutput1";
		ctp_pins_rst_output0 = "/fragment@5/__overlay__/rstoutput0";
		ctp_pins_rst_output1 = "/fragment@5/__overlay__/rstoutput1";
		fts_spi = "/fragment@6/__overlay__/fts_spi";
		fts_spi_default = "/fragment@7/__overlay__/spi_default";
		fts_spi_state = "/fragment@7/__overlay__/spi_state";
		accdet_pins_default = "/fragment@9/__overlay__/accdetdefault";
		accdet_pins_eint_as_int = "/fragment@9/__overlay__/accdeteint@0";
		accdet_audio_mode = "/fragment@9/__overlay__/accdetaudio@0";
		accdet_usb_mode = "/fragment@9/__overlay__/accdetusb@0";
		accdet_micswitch_high = "/fragment@9/__overlay__/micswitchhigh@0";
		accdet_micswitch_low = "/fragment@9/__overlay__/micswitchlow@0";
		aud_clk_mosi_off = "/fragment@11/__overlay__/aud_clk_mosi_off";
		aud_clk_mosi_on = "/fragment@11/__overlay__/aud_clk_mosi_on";
		aud_dat_mosi_off = "/fragment@11/__overlay__/aud_dat_mosi_off";
		aud_dat_mosi_on = "/fragment@11/__overlay__/aud_dat_mosi_on";
		aud_dat_miso_off = "/fragment@11/__overlay__/aud_dat_miso_off";
		aud_dat_miso_on = "/fragment@11/__overlay__/aud_dat_miso_on";
		aud_pins_smartpa_off = "/fragment@11/__overlay__/aud_pins_smartpa_off";
		aud_pins_smartpa_on = "/fragment@11/__overlay__/aud_pins_smartpa_on";
		vow_dat_miso_off = "/fragment@11/__overlay__/vow_dat_miso_off";
		vow_dat_miso_on = "/fragment@11/__overlay__/vow_dat_miso_on";
		vow_clk_miso_off = "/fragment@11/__overlay__/vow_clk_miso_off";
		vow_clk_miso_on = "/fragment@11/__overlay__/vow_clk_miso_on";
		consys_pins_default = "/fragment@12/__overlay__/consys_default";
		gpslna_pins_init = "/fragment@12/__overlay__/gpslna@0";
		gpslna_pins_oh = "/fragment@12/__overlay__/gpslna@1";
		gpslna_pins_ol = "/fragment@12/__overlay__/gpslna@2";
		camera_pins_cam0_rst_0 = "/fragment@14/__overlay__/cam0@0";
		camera_pins_cam0_rst_1 = "/fragment@14/__overlay__/cam0@1";
		camera_pins_cam0_pnd_0 = "/fragment@14/__overlay__/cam0@2";
		camera_pins_cam0_pnd_1 = "/fragment@14/__overlay__/cam0@3";
		camera_pins_cam1_rst_0 = "/fragment@14/__overlay__/cam1@0";
		camera_pins_cam1_rst_1 = "/fragment@14/__overlay__/cam1@1";
		camera_pins_cam1_pnd_0 = "/fragment@14/__overlay__/cam1@2";
		camera_pins_cam1_pnd_1 = "/fragment@14/__overlay__/cam1@3";
		camera_pins_cam2_rst_0 = "/fragment@14/__overlay__/cam2@0";
		camera_pins_cam2_rst_1 = "/fragment@14/__overlay__/cam2@1";
		camera_pins_cam2_pnd_0 = "/fragment@14/__overlay__/cam2@3";
		camera_pins_cam2_pnd_1 = "/fragment@14/__overlay__/cam2@4";
		camera_pins_cam2_vcamd_0 = "/fragment@14/__overlay__/cam2@vcam0";
		camera_pins_cam2_vcamd_1 = "/fragment@14/__overlay__/cam1@vcam1";
		camera_pins_cam2_vcama_0 = "/fragment@14/__overlay__/cam1@vcam2";
		camera_pins_cam2_vcama_1 = "/fragment@14/__overlay__/cam1@vcam3";
		camera_pins_cam0_mclk_on = "/fragment@14/__overlay__/camera_pins_cam0_mclk_on";
		camera_pins_cam0_mclk_off = "/fragment@14/__overlay__/camera_pins_cam0_mclk_off";
		camera_pins_cam1_mclk_off = "/fragment@14/__overlay__/camera_pins_cam1_mclk_off";
		camera_pins_cam1_mclk_on = "/fragment@14/__overlay__/camera_pins_cam1_mclk_on";
		camera_pins_cam2_mclk_off = "/fragment@14/__overlay__/camera_pins_cam2_mclk_off";
		camera_pins_cam2_mclk_on = "/fragment@14/__overlay__/camera_pins_cam2_mclk_on";
		camera_pins_default = "/fragment@14/__overlay__/camdefault";
		uart0_gpio_def_cfg = "/fragment@17/__overlay__/uart0gpiodefault";
		uart0_rx_set_cfg = "/fragment@17/__overlay__/uart0_rx_set@gpio95";
		uart0_rx_clr_cfg = "/fragment@17/__overlay__/uart0_rx_clear@gpio95";
		uart0_tx_set_cfg = "/fragment@17/__overlay__/uart0_tx_set@gpio96";
		uart0_tx_clr_cfg = "/fragment@17/__overlay__/uart0_tx_clear@gpio96";
		irtx_gpio_led_default = "/fragment@19/__overlay__/irtx_gpio_led_def@gpio90";
		irtx_gpio_led_set = "/fragment@19/__overlay__/irtx_gpio_led_set@gpio90";
		usb_default = "/fragment@22/__overlay__/usb_default";
		gpio_redriver_c1_init = "/fragment@22/__overlay__/c1_init";
		gpio_redriver_c1_low = "/fragment@22/__overlay__/c1_low";
		gpio_redriver_c1_hiz = "/fragment@22/__overlay__/c1_highz";
		gpio_redriver_c1_high = "/fragment@22/__overlay__/c1_high";
		gpio_redriver_c2_init = "/fragment@22/__overlay__/c2_init";
		gpio_redriver_c2_low = "/fragment@22/__overlay__/c2_low";
		gpio_redriver_c2_hiz = "/fragment@22/__overlay__/c2_highz";
		gpio_redriver_c2_high = "/fragment@22/__overlay__/c2_high";
		gpio_u3_switch_sel1 = "/fragment@22/__overlay__/u3_sw_sel1";
		gpio_u3_switch_sel2 = "/fragment@22/__overlay__/u3_sw_sel2";
		gpio_u3_switch_enable = "/fragment@22/__overlay__/u3_sw_en";
		gpio_u3_switch_disable = "/fragment@22/__overlay__/u3_sw_dis";
		otg_en_default = "/fragment@26/__overlay__/otg_en_default@gpio5";
		otg_en_high = "/fragment@26/__overlay__/otg_en_high@gpio5";
		otg_en_low = "/fragment@26/__overlay__/otg_en_low@gpio5";
		finger_pin_default = "/fragment@28/__overlay__/finger_pin_default";
		finger_power_en0 = "/fragment@28/__overlay__/finger_power_en@0";
		finger_power_en1 = "/fragment@28/__overlay__/finger_power_en@1";
		finger_reset_en0 = "/fragment@28/__overlay__/finger_reset_en@0";
		finger_reset_en1 = "/fragment@28/__overlay__/finger_reset_en@1";
		finger_int_as_int = "/fragment@28/__overlay__/finger_int_as_int@9";
		cap_touch_mtk = "/fragment@32/__overlay__/cap_touch@70";
		msensor_mtk = "/fragment@33/__overlay__/msensor@0c";
		alsps_mtk = "/fragment@33/__overlay__/alsps@51";
		barometer_mtk = "/fragment@33/__overlay__/barometer@77";
		camera_main_mtk = "/fragment@34/__overlay__/camera_main@1a";
		camera_main_af_mtk = "/fragment@34/__overlay__/camera_main_af@72";
		camera_main_eeprom_mtk = "/fragment@34/__overlay__/camera_main_eeprom@50";
		ccu_sensor_i2c_main_hw_mtk = "/fragment@34/__overlay__/ccu_sensor_i2c_main_hw@33";
		nfc_mtk = "/fragment@35/__overlay__/nfc@08";
		camera_main_two_mtk = "/fragment@36/__overlay__/camera_main_two@10";
		camera_main_two_af_mtk = "/fragment@36/__overlay__/camera_main_two_af@72";
		camera_main_two_eeprom_mtk = "/fragment@36/__overlay__/camera_main_two_eeprom@51";
		camera_sub_mtk = "/fragment@36/__overlay__/camera_sub@35";
		camera_sub_eeprom_mtk = "/fragment@36/__overlay__/camera_sub_eeprom@54";
		ccu_sensor_i2c_main2_hw_mtk = "/fragment@36/__overlay__/ccu_sensor_i2c_main2_hw@36";
		ccu_sensor_i2c_sub_hw_mtk = "/fragment@36/__overlay__/ccu_sensor_i2c_sub_hw@43";
		usb_type_c_mtk = "/fragment@37/__overlay__/usb_type_c@4e";
		subpmic_pmu_mtk = "/fragment@37/__overlay__/subpmic_pmu@34";
		slave_charger_mtk = "/fragment@38/__overlay__/slave_charger@4b";
	};

	__fixups__ {
		reserved_memory = "/fragment@0:target:0";
		chosen = "/fragment@1:target:0";
		odm = "/fragment@2:target:0";
		scp = "/fragment@3:target:0";
		touch = "/fragment@4:target:0\0/fragment@47:target:0\0/fragment@70:target:0";
		pio = "/fragment@5:target:0\0/fragment@7:target:0\0/fragment@8/__overlay__:micgnd-sel-gpio:0\0/fragment@8/__overlay__:usblr-sel-gpio:0\0/fragment@9:target:0\0/fragment@11:target:0\0/fragment@12:target:0\0/fragment@14:target:0\0/fragment@17:target:0\0/fragment@19:target:0\0/fragment@20/__overlay__:mt6370,intr_gpio:0\0/fragment@21/__overlay__:mt6370pd,intr_gpio:0\0/fragment@22:target:0\0/fragment@23/__overlay__/aw87329@58:reset-gpio:0\0/fragment@24/__overlay__/sy65153@4b:sy,en_gpio:0\0/fragment@24/__overlay__/sy65153@4b:sy,intr_gpio:0\0/fragment@26:target:0\0/fragment@27/__overlay__/microarray_fp@0:fingerprint,touch-int-gpio:0\0/fragment@28:target:0\0/fragment@33/__overlay__/alsps@51:interrupt-parent:0\0/fragment@44/__overlay__:GPIO_SIM2_SIO:0\0/fragment@44/__overlay__:GPIO_SIM2_SRST:0\0/fragment@44/__overlay__:GPIO_SIM2_SCLK:0\0/fragment@44/__overlay__:GPIO_SIM1_SCLK:0\0/fragment@44/__overlay__:GPIO_SIM1_SRST:0\0/fragment@44/__overlay__:GPIO_SIM1_SIO:0\0/fragment@44/__overlay__:GPIO_SIM2_HOT_PLUG:0\0/fragment@44/__overlay__:GPIO_SIM1_HOT_PLUG:0\0/fragment@46/__overlay__:interrupt-parent:0\0/fragment@46/__overlay__:deb-gpios:0\0/fragment@47/__overlay__:interrupt-parent:0\0/fragment@48/__overlay__:interrupt-parent:0\0/fragment@48/__overlay__:deb-gpios:0\0/fragment@49/__overlay__:interrupt-parent:0\0/fragment@50/__overlay__:interrupt-parent:0\0/fragment@51/__overlay__:interrupt-parent:0\0/fragment@51/__overlay__:deb-gpios:0\0/fragment@52/__overlay__:interrupt-parent:0\0/fragment@53/__overlay__:interrupt-parent:0\0/fragment@54/__overlay__:interrupt-parent:0\0/fragment@55/__overlay__:interrupt-parent:0\0/fragment@56/__overlay__:interrupt-parent:0\0/fragment@57/__overlay__:interrupt-parent:0\0/fragment@58/__overlay__:interrupt-parent:0\0/fragment@59/__overlay__:interrupt-parent:0";
		spi5 = "/fragment@6:target:0";
		accdet = "/fragment@8:target:0\0/fragment@51:target:0";
		audgpio = "/fragment@10:target:0";
		consys = "/fragment@13:target:0";
		kd_camera_hw1 = "/fragment@15:target:0\0/fragment@69:target:0";
		apuart0 = "/fragment@16:target:0";
		irtx_pwm = "/fragment@18:target:0";
		mt6370_pmu = "/fragment@20:target:0";
		mt6370_typec = "/fragment@21:target:0";
		i2c6 = "/fragment@23:target:0\0/fragment@38:target:0";
		i2c3 = "/fragment@24:target:0\0/fragment@35:target:0";
		usb_boost_manager = "/fragment@25:target:0";
		spi0 = "/fragment@27:target:0";
		microarray_fp = "/fragment@29:target:0";
		auxadc = "/fragment@30:target:0";
		pmic_clock_buffer_ctrl = "/fragment@31:target:0";
		i2c0 = "/fragment@32:target:0";
		i2c1 = "/fragment@33:target:0";
		i2c2 = "/fragment@34:target:0";
		i2c4 = "/fragment@36:target:0";
		i2c5 = "/fragment@37:target:0";
		i2c7 = "/fragment@39:target:0";
		i2c8 = "/fragment@40:target:0";
		i2c9 = "/fragment@41:target:0";
		i2c10 = "/fragment@42:target:0";
		i2c11 = "/fragment@43:target:0";
		gpio_usage_mapping = "/fragment@44:target:0";
		gpio = "/fragment@45:target:0";
		mrdump_ext_rst = "/fragment@46:target:0";
		msdc1_ins = "/fragment@48:target:0";
		gyro = "/fragment@49:target:0";
		mse = "/fragment@50:target:0";
		rt9465_slave_chr = "/fragment@52:target:0";
		subpmic_pmu_eint = "/fragment@53:target:0";
		tcpc_pd = "/fragment@54:target:0";
		dsi_te = "/fragment@55:target:0";
		irq_nfc = "/fragment@56:target:0";
		fingerprint = "/fragment@57:target:0";
		main_pmic = "/fragment@58:target:0";
		smart_pa = "/fragment@59:target:0";
		md1_sim1_hot_plug_eint = "/fragment@60:target:0";
		md1_sim2_hot_plug_eint = "/fragment@61:target:0";
		mt_pmic_vcama1_ldo_reg = "/fragment@62:target:0\0/fragment@69/__overlay__:vcama_sub-supply:0";
		mt_pmic_vcama2_ldo_reg = "/fragment@63:target:0\0/fragment@69/__overlay__:vcama-supply:0";
		mt_pmic_vsim1_ldo_reg = "/fragment@64:target:0";
		mt_pmic_vsim2_ldo_reg = "/fragment@65:target:0";
		mt_pmic_vcamd_ldo_reg = "/fragment@66:target:0\0/fragment@69/__overlay__:vcamd-supply:0\0/fragment@69/__overlay__:vcamd_sub-supply:0";
		mt_pmic_vcamio_ldo_reg = "/fragment@67:target:0\0/fragment@69/__overlay__:vcamio-supply:0\0/fragment@69/__overlay__:vcamio_sub-supply:0\0/fragment@69/__overlay__:vcamio_main2-supply:0";
		mt_pmic_vldo28_ldo_reg = "/fragment@68:target:0\0/fragment@69/__overlay__:vcamaf-supply:0\0/fragment@69/__overlay__:vcamaf_sub-supply:0\0/fragment@69/__overlay__:vcamaf_main2-supply:0\0/fragment@70/__overlay__:vtouch-supply:0";
		keypad = "/fragment@71:target:0";
	};

	__local_fixups__ {

		fragment@2 {

			__overlay__ {

				usb_c_pinctrl {
					pinctrl-0 = <0x00>;
					pinctrl-1 = <0x00>;
					pinctrl-2 = <0x00>;
					pinctrl-3 = <0x00>;
					pinctrl-4 = <0x00>;
					pinctrl-5 = <0x00>;
					pinctrl-6 = <0x00>;
					pinctrl-7 = <0x00>;
					pinctrl-8 = <0x00>;
					pinctrl-9 = <0x00>;
					pinctrl-10 = <0x00>;
					pinctrl-11 = <0x00>;
					pinctrl-12 = <0x00>;
				};
			};
		};

		fragment@4 {

			__overlay__ {
				pinctrl-0 = <0x00>;
				pinctrl-1 = <0x00>;
				pinctrl-2 = <0x00>;
				pinctrl-3 = <0x00>;
				pinctrl-4 = <0x00>;
				pinctrl-5 = <0x00>;
			};
		};

		fragment@6 {

			__overlay__ {

				fts_spi {
					pinctrl-0 = <0x00>;
					pinctrl-1 = <0x00>;
				};
			};
		};

		fragment@8 {

			__overlay__ {
				pinctrl-0 = <0x00>;
				pinctrl-1 = <0x00>;
				pinctrl-2 = <0x00>;
				pinctrl-3 = <0x00>;
				pinctrl-4 = <0x00>;
				pinctrl-5 = <0x00>;
			};
		};

		fragment@10 {

			__overlay__ {
				pinctrl-0 = <0x00>;
				pinctrl-1 = <0x00>;
				pinctrl-2 = <0x00>;
				pinctrl-3 = <0x00>;
				pinctrl-4 = <0x00>;
				pinctrl-5 = <0x00>;
				pinctrl-6 = <0x00>;
				pinctrl-7 = <0x00>;
				pinctrl-8 = <0x00>;
				pinctrl-9 = <0x00>;
				pinctrl-10 = <0x00>;
				pinctrl-11 = <0x00>;
			};
		};

		fragment@13 {

			__overlay__ {
				pinctrl-0 = <0x00>;
				pinctrl-1 = <0x00>;
				pinctrl-2 = <0x00>;
				pinctrl-3 = <0x00>;
			};
		};

		fragment@15 {

			__overlay__ {
				pinctrl-0 = <0x00>;
				pinctrl-1 = <0x00>;
				pinctrl-2 = <0x00>;
				pinctrl-3 = <0x00>;
				pinctrl-4 = <0x00>;
				pinctrl-5 = <0x00>;
				pinctrl-6 = <0x00>;
				pinctrl-7 = <0x00>;
				pinctrl-8 = <0x00>;
				pinctrl-9 = <0x00>;
				pinctrl-10 = <0x00>;
				pinctrl-11 = <0x00>;
				pinctrl-12 = <0x00>;
				pinctrl-13 = <0x00>;
				pinctrl-14 = <0x00>;
				pinctrl-15 = <0x00>;
				pinctrl-16 = <0x00>;
				pinctrl-17 = <0x00>;
				pinctrl-18 = <0x00>;
				pinctrl-19 = <0x00>;
				pinctrl-20 = <0x00>;
				pinctrl-21 = <0x00>;
				pinctrl-22 = <0x00>;
			};
		};

		fragment@16 {

			__overlay__ {
				pinctrl-0 = <0x00>;
				pinctrl-1 = <0x00>;
				pinctrl-2 = <0x00>;
				pinctrl-3 = <0x00>;
				pinctrl-4 = <0x00>;
			};
		};

		fragment@18 {

			__overlay__ {
				pinctrl-0 = <0x00>;
				pinctrl-1 = <0x00>;
			};
		};

		fragment@25 {

			__overlay__ {
				pinctrl-0 = <0x00>;
				pinctrl-1 = <0x00>;
				pinctrl-2 = <0x00>;
			};
		};

		fragment@29 {

			__overlay__ {
				pinctrl-0 = <0x00>;
				pinctrl-1 = <0x00>;
				pinctrl-2 = <0x00>;
				pinctrl-3 = <0x00>;
				pinctrl-4 = <0x00>;
				pinctrl-5 = <0x00>;
			};
		};
	};
};
